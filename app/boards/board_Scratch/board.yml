## app/boards/board_Scratch/board.yml
```yaml
board:
  name: board_Scratch
  full_name: board from Scratch
  vendor: by Me
  socs:
    - name: stm32f446xx
```

## app/boards/our_board/board.yml
```yaml
board:
  name: our_board
  full_name: our board
  vendor: by Me
  socs:
    - name: stm32f446xx
```

## twister-out.1/native_sim_native/host/homework.unit.ring_buf/Kconfig/arch/Kconfig
```kconfig
# Load Zephyr Arch Kconfig descriptions.
osource "/home/med_wassim_ben_ayed/deps/zephyr/arch/rx/Kconfig"
osource "/home/med_wassim_ben_ayed/deps/zephyr/arch/x86/Kconfig"
osource "/home/med_wassim_ben_ayed/deps/zephyr/arch/xtensa/Kconfig"
osource "/home/med_wassim_ben_ayed/deps/zephyr/arch/sparc/Kconfig"
osource "/home/med_wassim_ben_ayed/deps/zephyr/arch/riscv/Kconfig"
osource "/home/med_wassim_ben_ayed/deps/zephyr/arch/posix/Kconfig"
osource "/home/med_wassim_ben_ayed/deps/zephyr/arch/mips/Kconfig"
osource "/home/med_wassim_ben_ayed/deps/zephyr/arch/arm64/Kconfig"
osource "/home/med_wassim_ben_ayed/deps/zephyr/arch/arm/Kconfig"
osource "/home/med_wassim_ben_ayed/deps/zephyr/arch/arc/Kconfig"
```

## twister-out.1/native_sim_native/host/homework.unit.ring_buf/Kconfig/boards/Kconfig.sysbuild
```kconfig
# Load Sysbuild board Kconfig descriptions.
osource "/home/med_wassim_ben_ayed/deps/zephyr/boards/native/native_sim/Kconfig.sysbuild"
```

## twister-out/native_sim_native/host/homework.unit.ring_buf/Kconfig/boards/Kconfig.defconfig
```kconfig
# Load Zephyr board defconfig descriptions.
osource "/home/med_wassim_ben_ayed/deps/zephyr/boards/native/native_sim/Kconfig.defconfig"
```
