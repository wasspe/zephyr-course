## CMakeLists.txt
```
cmake_minimum_required(VERSION 3.20.0)

list(APPEND BOARD_ROOT ${CMAKE_CURRENT_SOURCE_DIR}/..)
find_package(Zephyr REQUIRED)
project(my_zephyr_app)

target_sources(app PRIVATE src/main.cpp)

add_subdirectory(drivers/our_drivers)
```

## kconfig
```
config APP_HEARTBEAT_PERIOD_MS
    int "Heartbeat LED period (ms)"
    range 100 2000
    default 500

source "Kconfig.zephyr"
```

## prj.conf
```kconfig
CONFIG_GPIO=y
CONFIG_LOG=y
CONFIG_CONSOLE=y
CONFIG_UART_CONSOLE=y
CONFIG_SERIAL=y
CONFIG_OUR_DRIVER=y
CONFIG_LOG_BACKEND_SHOW_COLOR=n
CONFIG_SHELL=y
CONFIG_SENSOR=y
```

## app.overlay
```dts
/ {
	our_driver0: our_driver{
		compatible = "our,driver";
		status = "okay";
		led = <&green_led_2>;
	};

	aliases {
		app-led = &green_led_2;
		};

};
```

## boards/board_Scratch/st_morpho_connector.dtsi
```dts
/*
 * Copyright (c) 2023 Marcin Niestroj
 * SPDX-License-Identifier: Apache-2.0
 */

#include <zephyr/dt-bindings/gpio/gpio.h>
#include <zephyr/dt-bindings/gpio/st-morpho-header.h>

/ {
	st_morpho_header: st-morpho-header {
		compatible = "st-morpho-header";
		#gpio-cells = <2>;
		gpio-map-mask = <ST_MORPHO_PIN_MASK 0x0>;
		gpio-map-pass-thru = <0x0 GPIO_DT_FLAGS_MASK>;
		gpio-map =
			   <ST_MORPHO_R_11 0 &gpioa 5 0>;
	};
};
```

## dts/bindings/our.driver.yaml
```yaml
description: "Simple LED-backed sensor"
compatible: "our,driver"

properties:
  led:
    type: phandle
    required: true
```

## src/main.cpp
```c
#include <zephyr/drivers/gpio.h>
#include <zephyr/kernel.h>
#include <zephyr/logging/log.h>

LOG_MODULE_REGISTER(main, LOG_LEVEL_INF);

int main(void)
{
    printk("Hello, World!\n");
    while (1) {
        
    }
    return 0;
}
```
